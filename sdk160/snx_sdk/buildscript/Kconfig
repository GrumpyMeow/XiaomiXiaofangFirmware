## sdk160/snx_sdk/kernel/linux-2.6.35.12/src/drivers/staging/Kconfig
```kconfig
menuconfig STAGING
	bool "Staging drivers"
	default n
	---help---
	  This option allows you to select a number of drivers that are
	  not of the "normal" Linux kernel quality level.  These drivers
	  are placed here in order to get a wider audience to make use of
	  them.  Please note that these drivers are under heavy
	  development, may or may not work, and may contain userspace
	  interfaces that most likely will be changed in the near
	  future.

	  Using any of these drivers will taint your kernel which might
	  affect support options from both the community, and various
	  commercial support organizations.

	  If you wish to work on these drivers, to help improve them, or
	  to report problems you have with them, please see the
	  driver_name.README file in the drivers/staging/ directory to
	  see what needs to be worked on, and who to contact.

	  If in doubt, say N here.


if STAGING

source "drivers/staging/et131x/Kconfig"

source "drivers/staging/slicoss/Kconfig"

source "drivers/staging/go7007/Kconfig"

source "drivers/staging/cx25821/Kconfig"

source "drivers/staging/tm6000/Kconfig"

source "drivers/staging/usbip/Kconfig"

source "drivers/staging/winbond/Kconfig"

source "drivers/staging/wlan-ng/Kconfig"

source "drivers/staging/echo/Kconfig"

source "drivers/staging/otus/Kconfig"

source "drivers/staging/rt2860/Kconfig"

source "drivers/staging/rt2870/Kconfig"

source "drivers/staging/comedi/Kconfig"

source "drivers/staging/asus_oled/Kconfig"

source "drivers/staging/panel/Kconfig"

source "drivers/staging/rtl8187se/Kconfig"

source "drivers/staging/rtl8188eu/Kconfig"

source "drivers/staging/rtl8192su/Kconfig"

source "drivers/staging/rtl8192u/Kconfig"

source "drivers/staging/rtl8192e/Kconfig"

source "drivers/staging/frontier/Kconfig"

source "drivers/staging/dream/Kconfig"

source "drivers/staging/pohmelfs/Kconfig"

source "drivers/staging/phison/Kconfig"

source "drivers/staging/line6/Kconfig"

source "drivers/gpu/drm/vmwgfx/Kconfig"

source "drivers/gpu/drm/nouveau/Kconfig"

source "drivers/staging/octeon/Kconfig"

source "drivers/staging/serqt_usb2/Kconfig"

source "drivers/staging/quatech_usb2/Kconfig"

source "drivers/staging/vt6655/Kconfig"

source "drivers/staging/vt6656/Kconfig"

source "drivers/staging/udlfb/Kconfig"

source "drivers/staging/hv/Kconfig"

source "drivers/staging/vme/Kconfig"

source "drivers/staging/rar_register/Kconfig"

source "drivers/staging/memrar/Kconfig"

source "drivers/staging/sep/Kconfig"

source "drivers/staging/iio/Kconfig"

source "drivers/staging/ramzswap/Kconfig"

source "drivers/staging/wlags49_h2/Kconfig"

source "drivers/staging/wlags49_h25/Kconfig"

source "drivers/staging/batman-adv/Kconfig"

source "drivers/staging/samsung-laptop/Kconfig"

source "drivers/staging/sm7xx/Kconfig"

source "drivers/staging/dt3155/Kconfig"

source "drivers/staging/dt3155v4l/Kconfig"

source "drivers/staging/crystalhd/Kconfig"

source "drivers/staging/cxt1e1/Kconfig"

source "drivers/staging/ti-st/Kconfig"

source "drivers/staging/adis16255/Kconfig"

source "drivers/staging/xgifb/Kconfig"

source "drivers/staging/mrst-touchscreen/Kconfig"

source "drivers/staging/msm/Kconfig"

endif # STAGING
```
